## sdkconfig.defaults
```kconfig
CONFIG_IDF_TARGET="esp32s3"
CONFIG_ESPTOOLPY_FLASHSIZE_4MB=y

CONFIG_PARTITION_TABLE_CUSTOM=y
CONFIG_PARTITION_TABLE_CUSTOM_FILENAME="partitions.csv"
CONFIG_PARTITION_TABLE_FILENAME="partitions.csv"

# USB Serial/JTAG peripheral for data transfer (GPIO 19/20).
# esptool auto-reset works natively with USJ — no button needed.
CONFIG_USJ_ENABLE_USB_SERIAL_JTAG=y

# Log output goes to UART0 (GPIO1/3) so the USB CDC stream carries
# only binary audio data, not interleaved ASCII log lines.
CONFIG_ESP_CONSOLE_UART_DEFAULT=y
CONFIG_ESP_CONSOLE_SECONDARY_NONE=y
```
